## uefi.its
```
/*
 * Copyright (C) 2020 Rockchip Electronic Co.,Ltd
 *
 * Simple U-boot fit source file containing ATF/OP-TEE/UEFI/dtb
 */

/dts-v1/;

/ {
	description = "FIT Image with ATF/OP-TEE/UEFI";
	#address-cells = <1>;

	images {
		uboot {
			description = "UEFI";
			data-position = <0x00100000>;
			data-size = <0x100000>;
			type = "standalone";
			arch = "arm64";
			os = "U-Boot";
			compression = "none";
			load = <0x00a00000>;
		};
		atf-1 {
			description = "ARM Trusted Firmware";
			data = /incbin/("./bl31_0x00040000.bin");
			type = "firmware";
			arch = "arm64";
			os = "arm-trusted-firmware";
			compression = "none";
			load = <0x00040000>;
			hash {
				algo = "sha256";
			};
		};
		atf-2 {
				description = "ARM Trusted Firmware";
				data = /incbin/("./bl31_0x00068000.bin");
				type = "firmware";
				arch = "arm64";
				os = "arm-trusted-firmware";
				compression = "none";
				load = <0x00068000>;
				hash {
						algo = "sha256";
				};
		};
		atf-3 {
			description = "ARM Trusted Firmware";
			data = /incbin/("./bl31_0xfdcd0000.bin");
			type = "firmware";
			arch = "arm64";
			os = "arm-trusted-firmware";
			compression = "none";
			load = <0xfdcd0000>;
			hash {
				algo = "sha256";
			};
		};
		atf-4 {
			description = "ARM Trusted Firmware";
			data = /incbin/("./bl31_0xfdcc9000.bin");
			type = "firmware";
			arch = "arm64";
			os = "arm-trusted-firmware";
			compression = "none";
			load = <0xfdcc9000>;
			hash {
				algo = "sha256";
			};
		};
		atf-5 {
				description = "ARM Trusted Firmware";
				data = /incbin/("./bl31_0x00066000.bin");
				type = "firmware";
				arch = "arm64";
				os = "arm-trusted-firmware";
				compression = "none";
				load = <0x00066000>;
				hash {
						algo = "sha256";
				};
		};
		optee {
			description = "OP-TEE";
			data = /incbin/("./edk2-rockchip-non-osi/rkbin/bin/rk35/rk3568_bl32_v2.01.bin");
			type = "firmware";
			arch = "arm64";
			os = "op-tee";
			compression = "none";
			load = <0x8400000>;
			hash {
				algo = "sha256";
			};
		};
		fdt {
			description = "UEFI dtb";
			data = /incbin/("./@BOARDTYPE@.dtb");
			type = "flat_dt";
			arch = "arm64";
			compression = "none";
			load = <0x00b00000>;
			hash {
				algo = "sha256";
			};
		};
	};

	configurations {
		default = "conf";
		conf {
			description = "@BOARDTYPE@";
			rollback-index = <0x0>;
			firmware = "atf-1";
			loadables = "uboot", "atf-2", "atf-3", "atf-4", "atf-5", "optee";
			
			fdt = "fdt";
			signature {
				algo = "sha256,rsa2048";
				padding = "pss";
				key-name-hint = "dev";
				sign-images = "fdt", "firmware", "loadables";
			};
		};
	};
};
```

## uefi_ROC-RK3566-PC.its
```
/*
 * Copyright (C) 2020 Rockchip Electronic Co.,Ltd
 *
 * Simple U-boot fit source file containing ATF/OP-TEE/UEFI/dtb
 */

/dts-v1/;

/ {
	description = "FIT Image with ATF/OP-TEE/UEFI";
	#address-cells = <1>;

	images {
		uboot {
			description = "UEFI";
			data = /incbin/("./Build/RK356X_EFI.fd");
			type = "standalone";
			arch = "arm64";
			os = "U-Boot";
			compression = "none";
			load = <0x00a00000>;
			hash {
				algo = "sha256";
			};
		};
		atf-1 {
			description = "ARM Trusted Firmware";
			data = /incbin/("./bl31_0x00040000.bin");
			type = "firmware";
			arch = "arm64";
			os = "arm-trusted-firmware";
			compression = "none";
			load = <0x00040000>;
			hash {
				algo = "sha256";
			};
		};
		atf-2 {
				description = "ARM Trusted Firmware";
				data = /incbin/("./bl31_0x00068000.bin");
				type = "firmware";
				arch = "arm64";
				os = "arm-trusted-firmware";
				compression = "none";
				load = <0x00068000>;
				hash {
						algo = "sha256";
				};
		};
		atf-3 {
			description = "ARM Trusted Firmware";
			data = /incbin/("./bl31_0xfdcd0000.bin");
			type = "firmware";
			arch = "arm64";
			os = "arm-trusted-firmware";
			compression = "none";
			load = <0xfdcd0000>;
			hash {
				algo = "sha256";
			};
		};
		atf-4 {
			description = "ARM Trusted Firmware";
			data = /incbin/("./bl31_0xfdcc9000.bin");
			type = "firmware";
			arch = "arm64";
			os = "arm-trusted-firmware";
			compression = "none";
			load = <0xfdcc9000>;
			hash {
				algo = "sha256";
			};
		};
		atf-5 {
				description = "ARM Trusted Firmware";
				data = /incbin/("./bl31_0x00066000.bin");
				type = "firmware";
				arch = "arm64";
				os = "arm-trusted-firmware";
				compression = "none";
				load = <0x00066000>;
				hash {
						algo = "sha256";
				};
		};
		optee {
			description = "OP-TEE";
			data = /incbin/("./rkbin/bin/rk35/rk3568_bl32_v2.01.bin");
			type = "firmware";
			arch = "arm64";
			os = "op-tee";
			compression = "none";
			load = <0x8400000>;
			hash {
				algo = "sha256";
			};
		};
		fdt {
			description = "UEFI dtb";
			data = /incbin/("./rk3566-firefly-roc-pc.dtb");
			type = "flat_dt";
			arch = "arm64";
			compression = "none";
			load = <0x00ae0000>;
			hash {
				algo = "sha256";
			};
		};
	};

	configurations {
		default = "conf";
		conf {
			description = "rk3566-roc-rk3566-pc";
			rollback-index = <0x0>;
			firmware = "atf-1";
			loadables = "uboot", "atf-2", "atf-3", "atf-4", "atf-5", "optee";
			
			fdt = "fdt";
			signature {
				algo = "sha256,rsa2048";
				padding = "pss";
				key-name-hint = "dev";
				sign-images = "fdt", "firmware", "loadables";
			};
		};
	};
};
```
